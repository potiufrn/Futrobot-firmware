## main/Kconfig.projbuild
```kconfig
# put here your custom config value
menu "Nome do ESP"
config  ESP_NAME
    string "Esp Name"
    default "Teste"
    help
  comentario aleatorio

config ESP_WIFI_PASSWORD
    string "WiFi Password"
    default "mypassword"
    help
	WiFi password (WPA or WPA2) for the example to use.
endmenu
```
